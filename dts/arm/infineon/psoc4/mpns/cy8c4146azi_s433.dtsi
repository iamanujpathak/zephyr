/*
 * SPDX-FileCopyrightText: Copyright (c) 2026 Infineon Technologies AG,
 * SPDX-FileCopyrightText: or an affiliate of Infineon Technologies AG. All rights reserved.
 *
 * SPDX-License-Identifier: Apache-2.0
 */

#include "../psoc4100s/psoc4100s.48-tqfp.dtsi"

&flash0 {
	reg = <0x00000000 DT_SIZE_K(64)>;
};

&sram0 {
	reg = <0x20000000 DT_SIZE_K(8)>;
};
