## drivers/usb/udc/Kconfig.wch_ch5xx
```kconfig
# Copyright (c) 2026 BIII Tech LLP.
# SPDX-License-Identifier: Apache-2.0

config UDC_WCH_CH5XX
	bool "WCH CH5xx USB Device Controller"
	default y
	depends on DT_HAS_WCH_CH5XX_USB_ENABLED
	select EVENTS
	help
	  Enable WCH CH5xx USB full-speed device controller driver.

if UDC_WCH_CH5XX

config UDC_WCH_CH5XX_STACK_SIZE
	int "UDC controller driver thread stack size"
	default 1024
	help
	  WCH CH5xx USB device controller driver thread stack size.

config UDC_WCH_CH5XX_THREAD_PRIORITY
	int "UDC controller driver thread priority"
	default 8
	help
	  WCH CH5xx USB device controller driver thread priority.

endif # UDC_WCH_CH5XX
```

## dts/bindings/spi/wch,ch5xx-spi.yaml
```yaml
# Copyright (c) 2025 MASSDRIVER EI (massdriver.space)
# SPDX-License-Identifier: Apache-2.0

description: WCH CH5XX SPI

compatible: "wch,ch5xx-spi"

include: [spi-controller.yaml, pinctrl-device.yaml]

properties:
  reg:
    required: true

  pinctrl-0:
    required: true

  pinctrl-names:
    required: true
```

## dts/bindings/usb/wch,ch5xx-usb.yaml
```yaml
# Copyright (c) 2026 BIII Tech LLP.
# SPDX-License-Identifier: Apache-2.0

description: WCH CH5xx USB Full-Speed Device Controller

compatible: "wch,ch5xx-usb"

include: usb-ep.yaml

properties:
  reg:
    required: true

  interrupts:
    required: true
```
