## drivers/opamp/Kconfig.infineon_ctbm
```kconfig
# SPDX-FileCopyrightText: Copyright (c) 2026 Infineon Technologies AG,
# SPDX-FileCopyrightText: or an affiliate of Infineon Technologies AG. All rights reserved.
#
# SPDX-License-Identifier: Apache-2.0

config OPAMP_INFINEON_CTBM
	bool "Infineon CTBm opamp driver"
	default y
	depends on DT_HAS_INFINEON_CTBM_OPAMP_ENABLED
	select USE_INFINEON_CTB
	select PINCTRL
	help
	  Enable the driver for the opamps of the Infineon M0S8 CTBm block, found
	  in PSOC 4 devices.
```

## dts/bindings/i2c/wch,i2c.yaml
```yaml
# Copyright (c) 2025 Andrei-Edward Popa
# SPDX-License-Identifier: Apache-2.0

description: WCH I2C controller

compatible: "wch,i2c"

include: [i2c-controller.yaml, pinctrl-device.yaml]

properties:
  reg:
    required: true

  clocks:
    description: |
      Clock gate to enable before the peripheral is used. Required on the
      ch32v family; the CH5xx block is fed from a fixed clock and omits it.

  interrupts:
    required: true

  pinctrl-0:
    required: true

  pinctrl-names:
    required: true
```

## dts/bindings/opamp/infineon,ctbm-opamp.yaml
```yaml
# SPDX-FileCopyrightText: Copyright (c) 2026 Infineon Technologies AG,
# SPDX-FileCopyrightText: or an affiliate of Infineon Technologies AG. All rights reserved.
#
# SPDX-License-Identifier: Apache-2.0

description: |
  Infineon M0S8 CTBm opamp, found in PSOC 4 devices.

  Each node describes one of the two opamps of a CTBm block, whose parent node
  holds the block base address. The inputs use the dedicated CTBm pins:
  OA0 non-inverting on pin 0 and inverting on pin 1 of the CTBm port, OA1
  non-inverting on pin 5 and inverting on pin 4. With out-to-pin, the output
  drives the dedicated pin (pin 2 for OA0, pin 3 for OA1) with the 10x output
  stage.

  Supported functional modes are "standalone", where external resistors set
  the gain, and "follower", where the inverting input is connected to the
  output internally.

compatible: "infineon,ctbm-opamp"

include:
  - name: opamp-controller.yaml

properties:
  reg:
    required: true
    description: Opamp index within the CTBm block (0 or 1).

  power-mode:
    type: string
    default: "medium"
    enum:
      - "low"
      - "medium"
      - "high"
    description: |
      Opamp power level, trading current consumption for bandwidth and output
      drive.

  out-to-pin:
    type: boolean
    description: |
      Drive the dedicated output pin with the 10x output stage, needed when
      external components are connected to the output.
```

## dts/bindings/opamp/infineon,ctbm.yaml
```yaml
# SPDX-FileCopyrightText: Copyright (c) 2026 Infineon Technologies AG,
# SPDX-FileCopyrightText: or an affiliate of Infineon Technologies AG. All rights reserved.
#
# SPDX-License-Identifier: Apache-2.0

description: |
  Infineon M0S8 CTBm (Continuous Time Block mini), found in PSOC 4 devices.

  The block holds two opamps, described by infineon,ctbm-opamp child nodes.

compatible: "infineon,ctbm"

include: base.yaml

properties:
  reg:
    required: true

  "#address-cells":
    const: 1

  "#size-cells":
    const: 0
```

## soc/infineon/psoc4/psoc4100s/Kconfig
```kconfig
# SPDX-FileCopyrightText: Copyright (c) 2026 Infineon Technologies AG,
# SPDX-FileCopyrightText: or an affiliate of Infineon Technologies AG. All rights reserved.
#
# SPDX-License-Identifier: Apache-2.0

# SOC Packages for Infineon PSOC4100S series MCUs
config SOC_PACKAGE_PSOC4100S_48_TQFP
	bool
	help
	  48-pin TQFP package

# Hardware configuration for PSOC4100S series
config SOC_SERIES_PSOC4100S
	select ARM
	select CPU_CORTEX_M0PLUS
	select CPU_HAS_ARM_MPU
	select CPU_CORTEX_M_HAS_VTOR
	select BUILD_OUTPUT_HEX
	select BUILD_OUTPUT_BIN
	select DYNAMIC_INTERRUPTS
	select SOC_EARLY_INIT_HOOK
	select CPU_CORTEX_M_HAS_SYSTICK
	select HAS_SEGGER_RTT

# Infineon PSOC4100S series MPNs
config SOC_CY8C4146AZI_S433
	select SOC_PACKAGE_PSOC4100S_48_TQFP
```

## soc/infineon/psoc4/psoc4100s/Kconfig.soc
```kconfig
# SPDX-FileCopyrightText: Copyright (c) 2026 Infineon Technologies AG,
# SPDX-FileCopyrightText: or an affiliate of Infineon Technologies AG. All rights reserved.
#
# SPDX-License-Identifier: Apache-2.0

# MCU series
config SOC_SERIES_PSOC4100S
	bool
	select SOC_FAMILY_INFINEON_PSOC4
	help
	  PSOC4100S Series MCU

config SOC_SERIES
	default "psoc4100s" if SOC_SERIES_PSOC4100S

config SOC_CY8C4146AZI_S433
	bool
	select SOC_SERIES_PSOC4100S

config SOC_CY8C4146LQI_S423
	bool
	select SOC_SERIES_PSOC4100S

# Default SOC selection
config SOC
	default "cy8c4146azi_s433" if SOC_CY8C4146AZI_S433
	default "cy8c4146lqi_s423" if SOC_CY8C4146LQI_S423
```
