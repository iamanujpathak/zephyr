/*
 * SPDX-FileCopyrightText: Copyright (c) 2026 Infineon Technologies AG,
 * SPDX-FileCopyrightText: or an affiliate of Infineon Technologies AG. All rights reserved.
 *
 * SPDX-License-Identifier: Apache-2.0
 */

&opamp0 {
	status = "okay";
	functional-mode = "standalone";
	out-to-pin;
};

&opamp1 {
	status = "okay";
	functional-mode = "follower";
	power-mode = "low";
};
