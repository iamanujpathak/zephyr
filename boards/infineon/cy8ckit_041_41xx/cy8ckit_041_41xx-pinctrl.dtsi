/*
 * SPDX-FileCopyrightText: Copyright (c) 2026 Infineon Technologies AG,
 * SPDX-FileCopyrightText: or an affiliate of Infineon Technologies AG. All rights reserved.
 *
 * SPDX-License-Identifier: Apache-2.0
 */

/* Configure pin drive mode for uart pins */
&p0_5_scb2_uart_tx {
	drive-push-pull;
};

&p0_4_scb2_uart_rx {
	input-enable;
};

/* Configure pin drive mode for i2c pins */
&p3_0_scb1_i2c_scl {
	drive-open-drain;
	input-enable;
};

&p3_1_scb1_i2c_sda {
	drive-open-drain;
	input-enable;
};
